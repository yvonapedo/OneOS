## components/lv_binding_js/src/deps/lvgl8.2/oneos_extra/Kconfig
```kconfig
menu "Extra"
    source "$OS_ROOT/components/gui/lvgl8.2/oneos_extra/*/Kconfig"
endmenu
```

## components/lv_binding_js/src/deps/lvgl8.2/oneos_extra/libs/Kconfig
```kconfig
menu "Libs"
    source "$OS_ROOT/components/gui/lvgl8.2/oneos_extra/libs/*/Kconfig"
endmenu
```

## components/lv_binding_js/src/deps/lvgl8.2/oneos_extra/libs/freetype/Kconfig
```kconfig
menu "FreeType"
   config OS_USING_LVGL_EXTRA_FREETYPE
        bool "Enable FreeType v2.12.1"
        select OS_USING_GUI_LVGL_FILESYSTEM
        default n
endmenu
```

## components/lv_binding_js/src/jsruntime/deps/quickjs/Kconfig
```kconfig
menu "QuickJS"

    config USING_QUICKJS
    bool "enable QuickJS"
    default n

endmenu
```
